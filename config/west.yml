## config/west.yml
```yaml
manifest:
  remotes:
    - name: zmkfirmware
      url_base: https://github.com/zmkfirmware
    - name: kumamuk
      url_base: https://github.com/kumamuk-git
  projects:
    - name: zmk
      remote: zmkfirmware
      revision: main
      import: app/west.yml
    - name: roBa
      remote: kumamuk
      revision: main
  self:
    path: config
```
